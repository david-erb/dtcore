## CMakeLists.txt
```
cmake_minimum_required(VERSION 3.20.0)

find_package(Zephyr REQUIRED HINTS $ENV{ZEPHYR_BASE})

project(app_zephyr)

include(${CMAKE_CURRENT_LIST_DIR}/../../dthelpers.cmake)
dthelpers_resolve(DTCORE_DIR "dtcore repo directory")

add_subdirectory(${DTCORE_DIR}/dtcore_tests          ${CMAKE_BINARY_DIR}/dtcore_tests)
add_subdirectory(${DTCORE_DIR}/dtcore_library        ${CMAKE_BINARY_DIR}/dtcore_library)

target_link_libraries(app PRIVATE 
    dtcore_tests
    dtcore_library)

target_sources(app PRIVATE
    src/main.c
)
```

## prj.conf
```kconfig
# ---- libc / printf
CONFIG_NEWLIB_LIBC=y
CONFIG_NEWLIB_LIBC_NANO=y
CONFIG_NEWLIB_LIBC_FLOAT_PRINTF=y

# ---- console (UART)
CONFIG_SERIAL=y
CONFIG_CONSOLE=y
CONFIG_UART_CONSOLE=y
CONFIG_STDOUT_CONSOLE=y
CONFIG_PRINTK=y

# ---- no logging
CONFIG_LOG=n

# ---- memory (start small)
CONFIG_MAIN_STACK_SIZE=2048
CONFIG_HEAP_MEM_POOL_SIZE=8192
```

## src/main.c
```c
#include <dtcore/dtlog.h>

#include <dtcore_tests.h>

#define TAG "test_all"

int
main()
{
    dtunittest_control_t unittest_control = { 0 };
    unittest_control.should_print_suites = true;
    unittest_control.should_print_tests = false;
    unittest_control.should_print_errors = true;

    test_dtcore_matching(&unittest_control);

    // print summary as final line of test output
    dtunittest_print_final(&unittest_control);

    exit(unittest_control.total_fail_count == 0 ? 0 : 1);
}
```
